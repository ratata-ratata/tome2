## config/boards/shields/tome2/Kconfig.defconfig
```kconfig
if SHIELD_TOME_LEFT

config ZMK_KEYBOARD_NAME
    default "Tome 2"

config ZMK_SPLIT_ROLE_CENTRAL
    default y

endif

if SHIELD_TOME_LEFT || SHIELD_TOME_RIGHT

config ZMK_SPLIT
    default y

endif
```

## config/boards/shields/tome2/Kconfig.shield
```kconfig
config SHIELD_TOME_LEFT
    def_bool $(shields_list_contains,tome2_left)

config SHIELD_TOME_RIGHT
    def_bool $(shields_list_contains,tome2_right)
```
